#include "shoedler54.dtsi"

&kscan0 {
    row-gpios
        = <&pro_micro 21 (GPIO_ACTIVE_HIGH | GPIO_PULL_DOWN)> // ergogen r4
        , <&pro_micro 18 (GPIO_ACTIVE_HIGH | GPIO_PULL_DOWN)> // ergogen r3
        , <&pro_micro 19 (GPIO_ACTIVE_HIGH | GPIO_PULL_DOWN)> // ergogen r2
        , <&pro_micro 20 (GPIO_ACTIVE_HIGH | GPIO_PULL_DOWN)> // ergogen r1
        , <&pro_micro 9  (GPIO_ACTIVE_HIGH | GPIO_PULL_DOWN)> // ergogen r0
        ;

    col-gpios
        = <&pro_micro 6  GPIO_ACTIVE_HIGH> // ergogen c0
        , <&pro_micro 5  GPIO_ACTIVE_HIGH> // ergogen c1
        , <&pro_micro 8  GPIO_ACTIVE_HIGH> // ergogen c2
        , <&pro_micro 16 GPIO_ACTIVE_HIGH> // ergogen c3
        , <&pro_micro 10 GPIO_ACTIVE_HIGH> // ergogen c4
        , <&pro_micro 4  GPIO_ACTIVE_HIGH> // ergogen c5
        ;
};
